## apps/device_inspector/source/sdkconfig.defaults
```kconfig
# The app uses GhostESP's API-table ABI, so the standalone build does not need
# elf_loader's large default host symbol exports.
# CONFIG_ELF_LOADER_LIBC_SYMBOLS is not set
# CONFIG_ELF_LOADER_ESPIDF_SYMBOLS is not set
CONFIG_ELF_DYNAMIC_LOAD_SHARED_OBJECT=y
CONFIG_SPIRAM=y
CONFIG_SPIRAM_MODE_OCT=y
CONFIG_SPIRAM_TYPE_AUTO=y
CONFIG_SPIRAM_SPEED_40M=y
CONFIG_SPIRAM_USE_MALLOC=y
CONFIG_ELF_LOADER_CACHE_OFFSET=y
CONFIG_ELF_LOADER_LOAD_PSRAM=y
CONFIG_ELF_LOADER_NUMBER_SYMBOLS=8
# CONFIG_COMPILER_OPTIMIZATION_DEBUG is not set
CONFIG_COMPILER_OPTIMIZATION_SIZE=y
# CONFIG_COMPILER_OPTIMIZATION_PERF is not set
# CONFIG_COMPILER_OPTIMIZATION_LEVEL_DEBUG is not set
CONFIG_COMPILER_OPTIMIZATION_LEVEL_RELEASE=y
```

## apps/esp32_finder/source/sdkconfig.defaults
```kconfig
CONFIG_ELF_LOADER=y
CONFIG_ELF_DYNAMIC_LOAD_SHARED_OBJECT=y
# CONFIG_COMPILER_OPTIMIZATION_DEBUG is not set
CONFIG_COMPILER_OPTIMIZATION_SIZE=y
# CONFIG_COMPILER_OPTIMIZATION_PERF is not set
# CONFIG_COMPILER_OPTIMIZATION_LEVEL_DEBUG is not set
CONFIG_COMPILER_OPTIMIZATION_LEVEL_RELEASE=y
```
